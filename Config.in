## Config.in
```kconfig
# Add project-specific packages for Buildroot here
#
# If these are non-proprietary, please consider contributing them back to
# Nerves or Buildroot.
menu "Custom Packages"

source "$NERVES_DEFCONFIG_DIR/packages/citronics-initramfs/Config.in"
source "$NERVES_DEFCONFIG_DIR/packages/unudhcpd/Config.in"
source "$NERVES_DEFCONFIG_DIR/packages/tb3-firmware/Config.in"
source "$NERVES_DEFCONFIG_DIR/packages/tb3-tools/Config.in"

menu "MediaTek MT8127 connectivity and cameras"
source "$NERVES_DEFCONFIG_DIR/packages/mt8127-btif/Config.in"
source "$NERVES_DEFCONFIG_DIR/packages/mt8127-consys/Config.in"
source "$NERVES_DEFCONFIG_DIR/packages/mt8127-wmt/Config.in"
source "$NERVES_DEFCONFIG_DIR/packages/mt8127-wlan/Config.in"
source "$NERVES_DEFCONFIG_DIR/packages/mt8127-bt/Config.in"
source "$NERVES_DEFCONFIG_DIR/packages/mt8127-fm/Config.in"
source "$NERVES_DEFCONFIG_DIR/packages/mt8127-camera/Config.in"
endmenu

endmenu
```

## packages/citronics-initramfs/Config.in
```kconfig
config BR2_PACKAGE_CITRONICS_INITRAMFS
	bool "citronics-initramfs [TB3-710F]"
	depends on !BR2_STATIC_LIBS
	depends on BR2_USE_MMU
	depends on BR2_TOOLCHAIN_HAS_THREADS
	depends on BR2_INSTALL_LIBSTDCPP
	depends on BR2_LINUX_KERNEL
	select BR2_PACKAGE_BUSYBOX
	select BR2_PACKAGE_UNUDHCPD
	select BR2_PACKAGE_MULTIPATH_TOOLS
	select BR2_PACKAGE_PARTED
	help
	  Early-boot initramfs, stored with the kernel in each boot
	  slot. It maps the Nerves partitions nested in the stock
	  userdata partition (mmcblk0p7) with kpartx, mounts the
	  active rootfs (nested partition 2) and switch_roots into
	  erlinit. When any step fails it brings up
	  USB networking (10.0.42.1, the PC gets 10.0.42.2) and a
	  telnet shell instead.
```

## packages/tb3-audio/Config.in
```kconfig
config BR2_PACKAGE_TB3_AUDIO
	bool "tb3-audio [TB3-710F]"
	depends on BR2_PACKAGE_ALSA_UTILS_ALSACTL
	help
	  Mixer defaults for the TB3-710F sound card (speaker and
	  internal microphone routed, headphone gain -5 dB + 8 dB) as
	  /var/lib/alsa/asound.state, for `alsactl --no-ucm -f <file>
	  restore` once the card has probed.
```

## packages/tb3-firmware/Config.in
```kconfig
config BR2_PACKAGE_TB3_FIRMWARE
	bool "tb3-firmware [TB3-710F]"
	help
	  Proprietary firmware of the Lenovo TB3-710F: the Silead touch
	  controller image, the CONSYS Wi-Fi/Bluetooth files (WMT patches,
	  Wi-Fi RAM code, WMT_SOC.cfg) and the FM patch. The files are not
	  redistributable and are taken from a local directory prepared
	  with buildroot-android's board/tb3_710f/scripts/prepare_firmware.sh.

if BR2_PACKAGE_TB3_FIRMWARE

config BR2_PACKAGE_TB3_FIRMWARE_DIR
	string "firmware directory"
	default "$(NERVES_DEFCONFIG_DIR)/firmware"
	help
	  Directory laid out like /lib/firmware that is copied into the
	  target. The default, firmware/ in this system, is git-ignored;
	  it may be a symlink to buildroot-android's
	  board/tb3_710f/firmware.

endif
```
